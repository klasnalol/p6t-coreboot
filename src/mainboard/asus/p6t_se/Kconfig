## src/mainboard/asus/p6t_se/Kconfig
```kconfig
# SPDX-License-Identifier: GPL-2.0-only

if BOARD_ASUS_P6T_SE

config BOARD_SPECIFIC_OPTIONS
	def_bool y
	select NORTHBRIDGE_INTEL_X58
	select SOUTHBRIDGE_INTEL_I82801JX
	select SUPERIO_WINBOND_W83667HG_A
	select HAVE_ACPI_TABLES
	select BOARD_ROMSIZE_KB_2048

config MAINBOARD_DIR
	default "asus/p6t_se"

config MAINBOARD_PART_NUMBER
	default "P6T SE"

endif
```

## src/mainboard/asus/p6t_se/Kconfig.name
```kconfig
## SPDX-License-Identifier: GPL-2.0-only

config BOARD_ASUS_P6T_SE
	bool "P6T SE"
```

## src/northbridge/intel/x58/Kconfig
```kconfig
# SPDX-License-Identifier: GPL-2.0-only

config NORTHBRIDGE_INTEL_X58
	bool
	select CPU_INTEL_MODEL_206CX
	select HAVE_DEBUG_RAM_SETUP
	select HAVE_X86_64_SUPPORT
	select DRAM_SUPPORT_DDR3
	select NEED_SMALL_2MB_PAGE_TABLES
	select SMM_TSEG
	select BOOT_DEVICE_SPI_FLASH_NO_EARLY_WRITES

if NORTHBRIDGE_INTEL_X58

config ECAM_MMCONF_BASE_ADDRESS
	default 0xe0000000

config ECAM_MMCONF_BUS_NUMBER
	int
	default 256

config DOMAIN_RESOURCE_32BIT_LIMIT
	default 0xfec00000


config DCACHE_RAM_BASE
	hex
	default 0xfefc0000

config DCACHE_RAM_SIZE
	hex
	default 0x40000

config DCACHE_BSP_STACK_SIZE
	hex
	default 0x2000
	help
	  Initial CAR stack size for X58/Westmere-EP bring-up.

config X58_MINIT_FILE
	string "Intel X58/Westmere MINIT binary path and filename"
	default "3rdparty/blobs/northbridge/intel/x58/MINITDLL.dll"
	help
	  Path to MINITDLL.dll extracted from the board's original firmware.
	  The binary is copied into CAR, PE-relocated, and used for DDR3 training.

config X58_CSI_INIT_FILE
	string "Intel X58 CSI/QPI initialization binary path and filename"
	default "3rdparty/blobs/northbridge/intel/x58/CSI_INITDLL.dll"
	help
	  Path to CSI_INITDLL.dll extracted from the board's original firmware.
	  The binary initializes the CPU-to-X58 coherent fabric before MINIT.

endif
```
